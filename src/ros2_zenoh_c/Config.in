## src/ros2_zenoh_c/Config.in
```kconfig
# Config.in for ros2_zenoh_c package
config BR2_PACKAGE_ROS2_ZENOH_C
	bool "ros2_zenoh_c"
	depends on BR2_TOOLCHAIN_HAS_THREADS
	help
	  ROS 2 Zenoh C library for Buildroot integration.
	  
	  This package provides a pure C library for ROS 2 message
	  publishing/subscribing over Zenoh networks.

	  https://github.com/your-repo/ros2_zenoh_c

if BR2_PACKAGE_ROS2_ZENOH_C

config BR2_PACKAGE_ROS2_ZENOH_C_ZENOH
	bool "Enable Zenoh support"
	default y
	help
	  Enable Zenoh networking support. Requires Zenoh C library.

config BR2_PACKAGE_ROS2_ZENOH_C_MICROCDR
	bool "Enable Micro-CDR serialization"
	default y
	help
	  Enable Micro-CDR message serialization support.

endif
```
